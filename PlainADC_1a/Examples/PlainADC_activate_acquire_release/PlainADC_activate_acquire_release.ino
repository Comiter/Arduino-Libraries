/*
 
	Example of use of the PlainADC library
	Default parameters are used: data are stored in 2 bytes integer format
	No need to care about the vector of data, nor with the way raw data is stored in the vector.
	This example exercises the reseting and setting of acquisition parameters
	Two different sampling frequencies are alternatively in use
	Optimized Digital to Analog Conversion for scanning mode
	Tested with ATmega328 powered Arduino boards
	Copyright (C) 2012-2013 Didier Longueville

	This program is free software: you can redistribute it and/or modify
	it under the terms of the GNU General Public License as published by
	the Free Software Foundation, either version 3 of the License, or
	(at your option) any later version.

	This program is distributed in the hope that it will be useful,
	but WITHOUT ANY WARRANTY; without even the implied warranty of
	MERCHANTABILITY or FITNESS FOR A PARTICULAR PURPOSE.  See the
	GNU General Public License for more details.

	You should have received a copy of the GNU General Public License
	along with this program.  If not, see <http://www.gnu.org/licenses/>.
	
*/

#include <PlainADC.h>
/* Create objects */
PlainADC pADC; /* Create ADC object */
/* Acquisition parameters */
const uint16_t adcChannel = 1; /* From 0 to 5 on ATmega328 powered Arduinos */
const uint16_t refVoltage = ADC_REF_VOL_DEFAULT; /* VCC: 5V */
const float samplingFrequency = 500.0; /* From 0.125 Hz to 130 kHz */
const uint16_t vSamples[] = {256, 512}; /* Max value depends upon available memory space */
const uint8_t dataFormat = ADC_DAT_FMT_INT;
const uint8_t options = (ADC_OPT_DIS_TIM_0 | ADC_OPT_DIS_TIM_2 | ADC_OPT_NOI_CANCELLER);

void setup(void)
{
	/* Initialize serial comm port */
	Serial.begin(115200); 
	/* Set data acquisition parameters */
	pADC.SetAcquisitionEngine(adcChannel, refVoltage, samplingFrequency, vSamples[0], dataFormat, options);	
	/* Diag only */
	Serial.print("Timer prescaler : ");
	Serial.print(TCCR1B & 0x07, DEC);
	Serial.println();
	Serial.print("Uppercount : ");
	Serial.print(OCR1A, DEC);
	Serial.println();	
	Serial.print("ADC prescaler : ");
	Serial.print(ADCSRA & 0x07, DEC);
	Serial.println();
	/* Mark event */
	BlinkLed(3);
}


void loop(void) 
{
	for (uint8_t i = 0; i < 2; i++) {
		/* Mark event */
		BlinkLed(1); 
		/* Reset and set acquisition parameters */
		pADC.ReleaseAcquisitionEngine();
		pADC.SetAcquisitionEngine(adcChannel, refVoltage, samplingFrequency, vSamples[i], dataFormat, options);	
		/* Acquire data */
		pADC.GetScanData();
		/* Print data */
		PrintData(vSamples[i]);			
		delay(3000); /* Repeat after delay */
	}
	// while(1); /* Run Once */
}


void PrintData(uint16_t samples) 
/* Print data from vector */
{
	for (uint16_t i = 0; i < samples; i++) {
		float abscissa = (i / samplingFrequency);
		Serial.print(abscissa, 6);
		Serial.print("\t");	
		float ordinate = pADC.ReadUInt16Data(i);
		ordinate *= (5.0 / 1024.0);
		// ordinate -= 2.5; /* Subtract offset in order to simplify the FFT spectral analysis */
		Serial.print(ordinate, 6);
		Serial.println();
	}
}


void BlinkLed(uint8_t cycles) 
/* Blink control led */
{
	/* Make the led pin an output pin */
	DDRB |= (1 << PINB5);
	/* Reset pin state */
	PORTB &= ~(1 << PINB5); /* Turn control led off */
	for (uint8_t i = 0; i < (cycles << 1); i++)	{
		delay(200);
		PORTB ^= (1 << PINB5);
	}
}