/*
 
	Example of use of the PlainADC library
	In this example, the pointer to the vector of data is returned on completion of
	parameter settings.
	Check Arduinoos blog for the possible variants of reading data
	Optimized Digital to Analog Conversion for scanning mode
	Tested with ATmega328 powered Arduino
	Copyright (C) 2012-2013 Didier Longueville

	This program is free software: you can redistribute it and/or modify
	it under the terms of the GNU General Public License as published by
	the Free Software Foundation, either version 3 of the License, or
	(at your option) any later version.

	This program is distributed in the hope that it will be useful,
	but WITHOUT ANY WARRANTY; without even the implied warranty of
	MERCHANTABILITY or FITNESS FOR A PARTICULAR PURPOSE.  See the
	GNU General Public License for more details.

	You should have received a copy of the GNU General Public License
	along with this program.  If not, see <http://www.gnu.org/licenses/>.
	
*/

#include <PlainADC.h>
/* Create objects */
PlainADC pADC; /* Create ADC object */
/* Acquisition parameters */
const uint16_t samples = 256; /* Max value depends upon available memory space */
const float samplingFrequency = 2000.0; /* From 0.125 Hz to 130 kHz */
const uint16_t adcChannel = 0; /* From 0 to 5 on ATmega328 powered Arduinos */
const uint16_t refVoltage = ADC_REF_VOL_DEFAULT; /* VCC: 5V */
const uint8_t dataFormat = ADC_DAT_FMT_DBL;
const uint8_t options = (ADC_OPT_NONE);
uint8_t *vData = NULL;
	
void setup(void)
{
	/* Initialize serial comm port */
	Serial.begin(115200); 
	/* Set data acquisition parameters and get memory location of data */
	vData = pADC.SetAcquisitionEngine(adcChannel, refVoltage,  samplingFrequency, samples, dataFormat, options);	
	/* Diag only */
	Serial.print("Timer prescaler : ");
	Serial.print(TCCR1B & 0x07, DEC);
	Serial.println();
	Serial.print("Uppercount : ");
	Serial.print(OCR1A, DEC);
	Serial.println();	
	Serial.print("ADC prescaler : ");
	Serial.print(ADCSRA & 0x07, DEC);
	Serial.println();
	/* Mark event */
	BlinkLed(3);
}


void loop(void) 
{
	/* Acquire data */
	pADC.GetScanData();
	/* Mark event */
	BlinkLed(1);
	/* Print data */
	PrintData();			
	// while(1); /* Run Once */
	delay(3000); /* Repeat after delay */
}


void PrintData(void) 
{
	/* Reinterpret the whole bytes vector in a float vector */
	float *vDbl32Data = reinterpret_cast<float*>(vData);
	for (uint16_t i = 0; i < samples; i++) {
		float abscissa = (i / samplingFrequency);
		Serial.print(abscissa, 6);
		Serial.print("\t");
		float ordinate = *(vDbl32Data + i);
		ordinate *= (5.0 / 1024.0);
		ordinate -= 2.5; /* Subtract offset in order to simplify the FFT spectral analysis */
		Serial.print(ordinate , 6);
		Serial.println();
	}
}


void PrintDataAlternate(void) 
/* Print data from vector */
{
	for (uint16_t i = 0; i < samples; i++) {
		float abscissa = (i / samplingFrequency);
		Serial.print(abscissa, 6);
		Serial.print("\t");
		float ordinate;
		/* Bit mapping for converting an array of bytes in a float */
		memcpy(&ordinate, &vData[(i << 2)], 4);
		ordinate *= (5.0 / 1024.0);
		ordinate -= 2.5; /* Subtract offset in order to simplify the FFT spectral analysis */
		Serial.print(ordinate, 6);
		Serial.println();
	}	
}


void BlinkLed(uint16_t cycles) 
/* Blink control led */
{
	/* Make the led pin an output pin */
	DDRB |= (1 << PINB5);
	/* Reset pin state */
	PORTB &= ~(1 << PINB5); /* Turn control led off */
	for (uint8_t i = 0; i < (cycles << 1); i++)	{
		delay(200);
		PORTB ^= (1 << PINB5);
	}
}